## boards/shields/origin/Kconfig.shield
```kconfig
config SHIELD_MY_BOARD_LEFT
    def_bool $(shields_list_contains,origin_left)

config SHIELD_MY_BOARD_RIGHT
    def_bool $(shields_list_contains,origin_right)
```
